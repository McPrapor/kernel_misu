## drivers/i2c/chips/Kconfig
```kconfig
menu "HTC Sensor Hub support"

config SENTRAL_IIO
        tristate "SENtral Sensor Hub (IIO)"
        depends on I2C && SYSFS && IIO && IIO_KFIFO_BUF
        default m
        help
          This driver supports the SENtral Sensor Hub using IIO
          This driver can be built as a module.

config HUB_SENTRAL_MFG
        tristate "SENtral Sensor Hub MFG FLAG FOR TURN OFF AUTOK"
        depends on I2C
        default n
        help
          sentral sensor hub MFG flag

config AK8789_HALLSENSOR
        bool "AK8789 hall sensor"
        default n

#config SENSORS_AK09916
#        tristate "AK09916 compass support"
#        default n
#        depends on I2C
#        help
#          If you say yes here you get support for Asahi Kasei's
#          orientation sensor AK09911.

config BOSCH_BMA253
        tristate "BMA253 acceleration sensor support"
        depends on I2C=y
        help
                If you say yes here you get support for Bosch Sensortec's
                acceleration sensors BMA253.

config BOSCH_BMA253_ENABLE_INT1
       tristate "BMA253 acceleration sensor interrupt INT1 support"
       depends on BOSCH_BMA253=y
        help
         If you say yes here you get INT1 support for Bosch Sensortec's
         acceleration sensors BMA253.

config BOSCH_BMA253_ENABLE_INT2
       tristate "BMA253 acceleration sensor interrupt INT2 support"
       depends on BOSCH_BMA253=y
       help
         If you say yes here you get INT2 support for Bosch Sensortec's
         acceleration sensors BMA253.

#config CIR_ALWAYS_READY
#        bool "BMA250 CIR Always Ready"
#	default n
#	help
#	  Enable CIR Always Ready

config INPUT_CAPELLA_CM36686
       tristate "CM36686 proximity and light sensor"
       help
       Say Y here to enable the CM36686 Short Distance Proximity
       Sensor with Ambient Light Sensor.

#config SENSORS_NFC_PN548
#        tristate "PN548 NFC sensor support"
#        depends on I2C=y
#        help
#          PN548 NFC Driver implemented.

#config INPUT_CWSTM32
#	tristate "CyWee CWSTM32 Sensor HUB"
#	depends on I2C && INPUT
#	select INPUT_POLLDEV
#	help
		This driver provides support for CWSTM32 Sensor HUB

#config INPUT_CWSTM32_V2
#	tristate "CyWee CWSTM32 Sensor HUB V2"
#	depends on I2C && INPUT
#	select INPUT_POLLDEV
#	help
#		This driver provides support for CWSTM32 Sensor HUB V2

#config CWSTM32_DEBUG
#	tristate "CyWee CWSTM32 Sensor HUB DEBUG MECHANISM"
#	depends on INPUT_CWSTM32
#	help
#		This driver depends on CWSTM32 Sensor HUB for enable DEBUG.

config SYNC_TOUCH_STATUS
    bool "Sync touch i2c switch status to sensor hub"
    default n
    help
        Sync touch i2c switch status to sensor hub

#config INPUT_LSM6DS3
#         tristate "STMicroelectronics LSM6DS3 sensor"
#         depends on (I2C || SPI_MASTER) && SYSFS
#		 select INPUT_LSM6DS3_I2C if I2C
#         help
#           This driver support the STMicroelectronics LSM6DS3 sensor.
#
#           To compile this driver as a module, choose M here. The module
#	   will be called lsm6ds3.

#config INPUT_LSM6DS3_I2C
#	tristate

endmenu
```

## drivers/misc/htc/Kconfig
```kconfig
#
# HTC MISC Driver Kconfig
#

config HTC_REBOOT_REASON_INFORMATION
	default y
	bool "HTC style reboot reason information features"
	help
	  Say Y here if you want the HTC style reboot reason information features
	  
config HTC_DEBUG_BOOTLOADER_LOG
	default y
	bool "HTC Bootloader Log Support"
	help
	  Say Y here if you want the HTC Bootloader Log Support


config HTC_VIRTUAL_DEV
	default n
	tristate "Audio Virtual Device Control"
	help
	  Say Y if you are using specific GPIO for AUdio device Control.

config HTC_POWER_PROFILING_6753
        default y
        bool "HTC style power profiling features"
        help
          Say Y here if you want the HTC power profiling features

config HTC_PROJECT_DTB
	string "HTC project DTB"
```

## drivers/misc/mediatek/accelerometer/bma250-new/Kconfig
```kconfig
config MTK_BMA250_NEW
	bool "BMA250 for MediaTek package"
	default n
	help
	  It support different accelerometer sensor.
          If this option is set,
	  it will support
          BMA250 Accelerometer.

config BMA250_V36BML_SWAP_XY
	bool "BMA250 swap X and Y axes"
	default n
	help
	  Swap X and Y axes for BMA250 accelerometer
```

## drivers/misc/mediatek/accelerometer/bma253-new/Kconfig
```kconfig
config MTK_BMA253_NEW
	bool "BMA253 for MediaTek package"
	default n
	help
	  It support different accelerometer sensor.
          If this option is set,
	  it will support
          BMA253 Accelerometer.

config BMA253_V36BML_SWAP_XY
        bool "BMA253 swap X and Y axes"
        default n
        help
          Swap X and Y axes for BMA253 accelerometer
```

## drivers/misc/mediatek/alsps/cm36686-new/Kconfig
```kconfig
config MTK_CM36686_NEW
	bool "cm36686 for MediaTek package"
	default n

config CM36686_V36BML_DIS_CALI
	bool "cm36686 temp cali disable"
	default n
```

## drivers/misc/mediatek/flashlight/Kconfig
```kconfig
config MTK_FLASHLIGHT
  bool CONFIG_MTK_FLASHLIGHT
  default n
  help
    CONFIG_MTK_FLASHLIGHT

config CUSTOM_KERNEL_FLASHLIGHT
        string "CUSTOM_KERNEL_FLASHLIGHT"
        help
          Kernel space cameara flashlight driver. You can use this driver
          choose cameara flashlight type.

config CPY83_S00_FLASHLIGHT
  bool CONFIG_CPY83_S00_FLASHLIGHT
  default n
  help
    CONFIG_CPY83_S00_FLASHLIGHT

config HTC_FLASHLIGHT_COMMON
        tristate "Common flashlight API for camera"
        help
          Say Y here to enable the common API for front flashlight utilization

config FLASHLIGHT_SY7803
        tristate "SILERGY SY7803 flashlight"
        help
          Say Y here to enable the SILERGY SY7803 flashlight

config FLASHLIGHT_SGM3785
        tristate "SGMICRO SGM3785 flashlight"
        help
          Say Y here to enable the SILERGY SGM3785 flashlight
```

## drivers/misc/mediatek/imgsensor/Kconfig
```kconfig
config MTK_IMGSENSOR
  bool CONFIG_MTK_IMGSENSOR
  default n
  help
    CONFIG_MTK_IMGSENSOR

config YL_CAM_MODULE_NAME
  bool CONFIG_YL_CAM_MODULE_NAME
  default n
  help
    CONFIG_YL_CAM_MODULE_NAME

config V36BML_CAMERA
  bool CONFIG_V36BML_CAMERA
  default n
  help
    HTC v36bml camera related option
```

## sound/soc/htc/Kconfig
```kconfig
#
# HTC MISC Driver Kconfig
#

config HTC_VIRTUAL_DEV
	default n
	tristate "Audio Virtual Device Control"
	help
	  Say Y if you are using specific GPIO for AUdio device Control.
```
